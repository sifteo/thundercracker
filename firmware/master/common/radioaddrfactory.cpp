/* -*- mode: C; c-basic-offset: 4; intent-tabs-mode: nil -*-
 *
 * Thundercracker firmware
 *
 * Copyright <c> 2012 Sifteo, Inc.
 *
 * Permission is hereby granted, free of charge, to any person obtaining a copy
 * of this software and associated documentation files (the "Software"), to deal
 * in the Software without restriction, including without limitation the rights
 * to use, copy, modify, merge, publish, distribute, sublicense, and/or sell
 * copies of the Software, and to permit persons to whom the Software is
 * furnished to do so, subject to the following conditions:
 * 
 * The above copyright notice and this permission notice shall be included in
 * all copies or substantial portions of the Software.
 * 
 * THE SOFTWARE IS PROVIDED "AS IS", WITHOUT WARRANTY OF ANY KIND, EXPRESS OR
 * IMPLIED, INCLUDING BUT NOT LIMITED TO THE WARRANTIES OF MERCHANTABILITY,
 * FITNESS FOR A PARTICULAR PURPOSE AND NONINFRINGEMENT. IN NO EVENT SHALL THE
 * AUTHORS OR COPYRIGHT HOLDERS BE LIABLE FOR ANY CLAIM, DAMAGES OR OTHER
 * LIABILITY, WHETHER IN AN ACTION OF CONTRACT, TORT OR OTHERWISE, ARISING FROM,
 * OUT OF OR IN CONNECTION WITH THE SOFTWARE OR THE USE OR OTHER DEALINGS IN
 * THE SOFTWARE.
 */

#include <protocol.h>
#include "radioaddrfactory.h"

const uint8_t RadioAddrFactory::gf84[0x100] = {
    // Lookup table for Galois Field multiplication by our chosen polynomial, 0x84.
    0x00, 0x84, 0x13, 0x97, 0x26, 0xa2, 0x35, 0xb1, 0x4c, 0xc8, 0x5f, 0xdb, 0x6a, 0xee, 0x79, 0xfd,
    0x98, 0x1c, 0x8b, 0x0f, 0xbe, 0x3a, 0xad, 0x29, 0xd4, 0x50, 0xc7, 0x43, 0xf2, 0x76, 0xe1, 0x65,
    0x2b, 0xaf, 0x38, 0xbc, 0x0d, 0x89, 0x1e, 0x9a, 0x67, 0xe3, 0x74, 0xf0, 0x41, 0xc5, 0x52, 0xd6,
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    0x49, 0xcd, 0x5a, 0xde, 0x6f, 0xeb, 0x7c, 0xf8, 0x05, 0x81, 0x16, 0x92, 0x23, 0xa7, 0x30, 0xb4
};


void RadioAddrFactory::random(RadioAddress &addr, _SYSPseudoRandomState &prng)
{
    addr.channel = RadioManager::suggestChannel();

    for (unsigned i = 0; i < arraysize(addr.id); ++i) {
        unsigned value = PRNG::valueBounded(&prng, 255 - 4) + 1;
        if (value >= 0x55) value++;
        if (value >= 0xAA) value++;
        ASSERT(allowedByte(value));
        addr.id[i] = value;
    }
}

void RadioAddrFactory::fromHardwareID(RadioAddress &addr, uint64_t hwid)
{
    // Low 8 bits of HWID are a version code.
    const uint8_t cubeVersion = hwid & 0xff;
    uint8_t reg;

    // Feed first two bytes into CRC, to collect entropy
    reg =      0xB4 ^ hwid; hwid >>= 8;
    reg = gf84[reg] ^ hwid; hwid >>= 8;

    for (unsigned i = 0; i < 5; ++i) {
        // Each of the next five bytes clock out an address byte
        reg = gf84[reg] ^ hwid; hwid >>= 8;

        // Explicitly avoid disallowed values
        while (!allowedByte(reg))
            reg = ~gf84[reg];

        addr.id[i] = reg;
    }

    // Pick a legal channel, using the last entropy byte
    reg = gf84[reg] ^ hwid; hwid >>= 8;

    /*
     * There are at least a handful of cubes out there in the world that were
     * shipped with non-fcc-compliant RF channel configurations. If we're
     * talking to one of them, go ahead and break the rules, in order to
     * maintain backwards compatibility and the ability to talk to them.
     */
    uint8_t minRfChannel, maxRfChannel;
    rfMinMaxChannels(minRfChannel, maxRfChannel, cubeVersion);

    for (;;) {
        addr.channel = reg & 0x7F;
        if (minRfChannel <= addr.channel && addr.channel <= maxRfChannel)
            break;
        reg = ~gf84[reg];
    }
}

/*
 * This is a one-way conversion from an address' primary channel
 * (as generated by fromHardwareID()), to its alternate.
 *
 * For example, disconnected cubes toggle between their primary
 * and alternate channels listening for connection beacons.
 */
void RadioAddrFactory::convertPrimaryToAlternateChannel(RadioAddress &addr, uint8_t cubeVersion)
{
    uint8_t minRfChannel, maxRfChannel;
    rfMinMaxChannels(minRfChannel, maxRfChannel, cubeVersion);

    /*
     * Alternate channel is the channel rotated by half our legal range,
     * wrapped at MIN_RF_CHANNEL
     */

    unsigned rotated = addr.channel + ((maxRfChannel - minRfChannel) / 2);
    if (rotated > maxRfChannel) {
        addr.channel = rotated - maxRfChannel - 1 + minRfChannel;
    } else {
        addr.channel = rotated;
    }
}
